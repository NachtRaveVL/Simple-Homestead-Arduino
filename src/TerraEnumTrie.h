/*  Terraduino enum decoding tree.
    Generated by tests/generate_enum_trie.py. Do not hand edit.
*/

#ifndef TerraEnumTrie_H
#define TerraEnumTrie_H

inline Terra_ObjectType terraDecodeObjectType(const TerraString &objectTypeStr)
{
    switch (terraTrieChar(objectTypeStr, 2)) {
        case 'd':
            return Terra_ObjectType_Undefined;
        case 'e':
            switch (terraTrieChar(objectTypeStr, 7)) {
                case 'l':
                    return Terra_ObjectType_ThermalLoop;
                case 's':
                    return Terra_ObjectType_ThermalStore;
            }
            return Terra_ObjectType_Undefined;
        case 'i':
            return Terra_ObjectType_RainCatchment;
        case 'n':
            return Terra_ObjectType_Sensor;
        case 's':
            return Terra_ObjectType_Resource;
        case 't':
            switch (terraTrieChar(objectTypeStr, 9)) {
                case '\0':
                    return Terra_ObjectType_Actuator;
                case 'a':
                    return Terra_ObjectType_WaterStorage;
                case 'c':
                    return Terra_ObjectType_WaterSource;
                case 'e':
                    return Terra_ObjectType_WaterRoute;
            }
            return Terra_ObjectType_Undefined;
        case 'v':
            return Terra_ObjectType_Environment;
        case 'w':
            return Terra_ObjectType_PowerRail;
    }
    return Terra_ObjectType_Undefined;
}

inline Terra_ResourceType terraDecodeResourceType(const TerraString &resourceTypeStr)
{
    switch (terraTrieChar(resourceTypeStr, 0)) {
        case 't':
            return Terra_ResourceType_Thermal;
        case 'u':
            return Terra_ResourceType_Undefined;
        case 'w':
            return Terra_ResourceType_Water;
    }
    return Terra_ResourceType_Undefined;
}

inline Terra_ResourceState terraDecodeResourceState(const TerraString &resourceStateStr)
{
    switch (terraTrieChar(resourceStateStr, 0)) {
        case 'f':
            return Terra_ResourceState_Fault;
        case 'h':
            return Terra_ResourceState_High;
        case 'l':
            return Terra_ResourceState_Low;
        case 'n':
            return Terra_ResourceState_Normal;
        case 'r':
            return Terra_ResourceState_Reserve;
        case 'u':
            return Terra_ResourceState_Unknown;
    }
    return Terra_ResourceState_Unknown;
}

inline Terra_WaterSourceType terraDecodeWaterSourceType(const TerraString &waterSourceTypeStr)
{
    switch (terraTrieChar(waterSourceTypeStr, 2)) {
        case 'c':
            return Terra_WaterSourceType_Reclaimed;
        case 'd':
            return Terra_WaterSourceType_Undefined;
        case 'i':
            return Terra_WaterSourceType_Rainwater;
        case 'l':
            return Terra_WaterSourceType_Well;
        case 'n':
            return Terra_WaterSourceType_Municipal;
        case 'o':
            return Terra_WaterSourceType_Stored;
        case 'r':
            return Terra_WaterSourceType_Surface;
    }
    return Terra_WaterSourceType_Undefined;
}

inline Terra_WaterStorageType terraDecodeWaterStorageType(const TerraString &waterStorageTypeStr)
{
    switch (terraTrieChar(waterStorageTypeStr, 0)) {
        case 'c':
            return Terra_WaterStorageType_Cistern;
        case 'r':
            return Terra_WaterStorageType_Reservoir;
        case 't':
            return Terra_WaterStorageType_Tank;
        case 'u':
            return Terra_WaterStorageType_Undefined;
    }
    return Terra_WaterStorageType_Undefined;
}

inline Terra_SensorType terraDecodeSensorType(const TerraString &sensorTypeStr)
{
    switch (terraTrieChar(sensorTypeStr, 8)) {
        case '\0':
            switch (terraTrieChar(sensorTypeStr, 3)) {
                case 'a':
                    return Terra_SensorType_Binary;
                case 'e':
                    return Terra_SensorType_Level;
                case 'i':
                    return Terra_SensorType_Humidity;
                case 'k':
                    return Terra_SensorType_Leak;
                case 'l':
                    return Terra_SensorType_Analog;
                case 'n':
                    return Terra_SensorType_Rainfall;
                case 'o':
                    return Terra_SensorType_Remote;
                case 'r':
                    return Terra_SensorType_Current;
                case 's':
                    return Terra_SensorType_Pressure;
                case 't':
                    return Terra_SensorType_Voltage;
                case 'w':
                    return Terra_SensorType_Flow;
            }
            return Terra_SensorType_Undefined;
        case 'c':
            return Terra_SensorType_WindDirection;
        case 'd':
            switch (terraTrieChar(sensorTypeStr, 0)) {
                case 'u':
                    return Terra_SensorType_Undefined;
                case 'w':
                    return Terra_SensorType_WindSpeed;
            }
            return Terra_SensorType_Undefined;
        case 'i':
            return Terra_SensorType_SolarRadiation;
        case 'u':
            return Terra_SensorType_Temperature;
    }
    return Terra_SensorType_Undefined;
}

inline Terra_ActuatorType terraDecodeActuatorType(const TerraString &actuatorTypeStr)
{
    switch (terraTrieChar(actuatorTypeStr, 4)) {
        case '\0':
            return Terra_ActuatorType_Pump;
        case 'a':
            return Terra_ActuatorType_Variable;
        case 'e':
            switch (terraTrieChar(actuatorTypeStr, 0)) {
                case 'h':
                    return Terra_ActuatorType_Heater;
                case 'v':
                    return Terra_ActuatorType_Valve;
            }
            return Terra_ActuatorType_Undefined;
        case 'f':
            return Terra_ActuatorType_Undefined;
        case 'p':
            return Terra_ActuatorType_SumpPump;
        case 'r':
            return Terra_ActuatorType_Diverter;
        case 't':
            return Terra_ActuatorType_Digital;
        case 'u':
            return Terra_ActuatorType_Circulator;
    }
    return Terra_ActuatorType_Undefined;
}

inline Terra_MeasurementMode terraDecodeMeasurementMode(const TerraString &measurementModeStr)
{
    switch (terraTrieChar(measurementModeStr, 0)) {
        case 'c':
            return Terra_MeasurementMode_Count;
        case 'i':
            return Terra_MeasurementMode_Imperial;
        case 'm':
            return Terra_MeasurementMode_Metric;
        case 's':
            return Terra_MeasurementMode_Scientific;
        case 'u':
            return Terra_MeasurementMode_Undefined;
    }
    return Terra_MeasurementMode_Undefined;
}

inline Terra_EnableMode terraDecodeEnableMode(const TerraString &enableModeStr)
{
    switch (terraTrieChar(enableModeStr, 0)) {
        case 'a':
            return Terra_EnableMode_Average;
        case 'c':
            return Terra_EnableMode_Count;
        case 'h':
            return Terra_EnableMode_Highest;
        case 'i':
            return Terra_EnableMode_InOrder;
        case 'l':
            return Terra_EnableMode_Lowest;
        case 'm':
            return Terra_EnableMode_Multiply;
        case 'r':
            return Terra_EnableMode_RevOrder;
        case 'u':
            return Terra_EnableMode_Undefined;
    }
    return Terra_EnableMode_Undefined;
}

inline Terra_PinMode terraDecodePinMode(const TerraString &pinModeStr)
{
    switch (terraTrieChar(pinModeStr, 7)) {
        case '\0':
            return Terra_PinMode_Count;
        case 'e':
            return Terra_PinMode_Undefined;
        case 'i':
            switch (terraTrieChar(pinModeStr, 16)) {
                case '\0':
                    return Terra_PinMode_Digital_Input;
                case 'd':
                    return Terra_PinMode_Digital_Input_PullDown;
                case 'u':
                    return Terra_PinMode_Digital_Input_PullUp;
            }
            return Terra_PinMode_Undefined;
        case 'n':
            return Terra_PinMode_Analog_Input;
        case 'o':
            return Terra_PinMode_Digital_Output;
        case 'u':
            return Terra_PinMode_Analog_Output;
    }
    return Terra_PinMode_Undefined;
}

inline Terra_Unit terraDecodeUnit(const TerraString &unitStr)
{
    switch (terraTrieChar(unitStr, 3)) {
        case '\0':
            switch (terraTrieChar(unitStr, 0)) {
                case '%':
                    return Terra_Unit_Percent;
                case 'a':
                    return Terra_Unit_Amps;
                case 'c':
                    return Terra_Unit_Celsius;
                case 'd':
                    return Terra_Unit_Degrees;
                case 'f':
                    return Terra_Unit_Fahrenheit;
                case 'g':
                    return Terra_Unit_GallonsUS;
                case 'h':
                    return Terra_Unit_Hectopascals;
                case 'i':
                    return Terra_Unit_Inches;
                case 'k':
                    switch (terraTrieChar(unitStr, 1)) {
                        case '\0':
                            return Terra_Unit_Kelvin;
                        case 'p':
                            return Terra_Unit_Kilopascals;
                        case 'w':
                            return Terra_Unit_KilowattHours;
                    }
                    return Terra_Unit_Undefined;
                case 'l':
                    return Terra_Unit_Liters;
                case 'm':
                    switch (terraTrieChar(unitStr, 1)) {
                        case '/':
                            return Terra_Unit_MetersPerSecond;
                        case 'm':
                            return Terra_Unit_Millimeters;
                        case 'p':
                            return Terra_Unit_MilesPerHour;
                    }
                    return Terra_Unit_Undefined;
                case 'p':
                    return Terra_Unit_PSI;
                case 'r':
                    return Terra_Unit_Raw;
                case 'v':
                    return Terra_Unit_Volts;
                case 'w':
                    return Terra_Unit_Watts;
            }
            return Terra_Unit_Undefined;
        case '/':
            return Terra_Unit_GallonsPerMinute;
        case '2':
            return Terra_Unit_WattsPerSquareMeter;
        case 'e':
            return Terra_Unit_Undefined;
        case 'h':
            switch (terraTrieChar(unitStr, 0)) {
                case 'i':
                    return Terra_Unit_InchesPerHour;
                case 'k':
                    return Terra_Unit_KilometersPerHour;
                case 'm':
                    return Terra_Unit_MillimetersPerHour;
            }
            return Terra_Unit_Undefined;
        case 'i':
            return Terra_Unit_LitersPerMinute;
    }
    return Terra_Unit_Undefined;
}

inline Terra_UnitsCategory terraDecodeUnitsCategory(const TerraString &unitsCategoryStr)
{
    switch (terraTrieChar(unitsCategoryStr, 6)) {
        case '\0':
            switch (terraTrieChar(unitsCategoryStr, 0)) {
                case 'a':
                    return Terra_UnitsCategory_Angle;
                case 'c':
                    return Terra_UnitsCategory_Count;
                case 'e':
                    return Terra_UnitsCategory_Energy;
                case 'p':
                    return Terra_UnitsCategory_Power;
                case 'r':
                    return Terra_UnitsCategory_Raw;
                case 's':
                    return Terra_UnitsCategory_Speed;
            }
            return Terra_UnitsCategory_Undefined;
        case 'a':
            switch (terraTrieChar(unitsCategoryStr, 0)) {
                case 'i':
                    return Terra_UnitsCategory_Irradiance;
                case 't':
                    return Terra_UnitsCategory_Temperature;
            }
            return Terra_UnitsCategory_Undefined;
        case 'c':
            return Terra_UnitsCategory_Distance;
        case 'e':
            return Terra_UnitsCategory_Voltage;
        case 'f':
            return Terra_UnitsCategory_LiquidFlowRate;
        case 'n':
            return Terra_UnitsCategory_Undefined;
        case 'r':
            return Terra_UnitsCategory_Pressure;
        case 't':
            switch (terraTrieChar(unitsCategoryStr, 0)) {
                case 'c':
                    return Terra_UnitsCategory_Current;
                case 'p':
                    return Terra_UnitsCategory_Percentile;
                case 'r':
                    return Terra_UnitsCategory_RainRate;
            }
            return Terra_UnitsCategory_Undefined;
        case 'v':
            return Terra_UnitsCategory_LiquidVolume;
    }
    return Terra_UnitsCategory_Undefined;
}

inline Terra_RailType terraDecodeRailType(const TerraString &railTypeStr)
{
    switch (terraTrieChar(railTypeStr, 2)) {
        case '1':
            return Terra_RailType_DC12V;
        case '2':
            return Terra_RailType_DC24V;
        case '3':
            return Terra_RailType_DC3V3;
        case '5':
            return Terra_RailType_DC5V;
        case 'd':
            return Terra_RailType_Undefined;
        case 's':
            return Terra_RailType_Custom;
        case 'u':
            return Terra_RailType_Count;
    }
    return Terra_RailType_Undefined;
}

inline Terra_Comparison terraDecodeComparison(const TerraString &comparisonStr)
{
    switch (terraTrieChar(comparisonStr, 7)) {
        case '\0':
            return Terra_Comparison_Equal;
        case 'l':
            return Terra_Comparison_NotEqual;
        case 'n':
            return Terra_Comparison_LessThan;
        case 'o':
            return Terra_Comparison_GreaterOrEqual;
        case 'q':
            return Terra_Comparison_LessOrEqual;
        case 't':
            return Terra_Comparison_GreaterThan;
    }
    return Terra_Comparison_GreaterOrEqual;
}

inline Terra_TriggerState terraDecodeTriggerState(const TerraString &triggerStateStr)
{
    switch (terraTrieChar(triggerStateStr, 0)) {
        case 'a':
            return Terra_TriggerState_Active;
        case 'f':
            return Terra_TriggerState_Fault;
        case 'i':
            return Terra_TriggerState_Inactive;
    }
    return Terra_TriggerState_Fault;
}

inline Terra_LogLevel terraDecodeLogLevel(const TerraString &logLevelStr)
{
    switch (terraTrieChar(logLevelStr, 0)) {
        case 'd':
            return Terra_LogLevel_Debug;
        case 'e':
            return Terra_LogLevel_Error;
        case 'i':
            return Terra_LogLevel_Info;
        case 'w':
            return Terra_LogLevel_Warning;
    }
    return Terra_LogLevel_Info;
}

inline Terra_ModuleType terraDecodeModuleType(const TerraString &moduleTypeStr)
{
    switch (terraTrieChar(moduleTypeStr, 3)) {
        case '\0':
            return Terra_ModuleType_RTC;
        case 'e':
            return Terra_ModuleType_Undefined;
        case 'i':
            return Terra_ModuleType_Radio;
        case 'p':
            return Terra_ModuleType_Display;
        case 'r':
            return Terra_ModuleType_Storage;
        case 'w':
            return Terra_ModuleType_Network;
        case 'x':
            return Terra_ModuleType_IOExpander;
    }
    return Terra_ModuleType_Undefined;
}

inline Terra_ControlMode terraDecodeControlMode(const TerraString &controlModeStr)
{
    switch (terraTrieChar(controlModeStr, 0)) {
        case 'a':
            return Terra_ControlMode_Automatic;
        case 'd':
            return Terra_ControlMode_Disabled;
        case 'm':
            return Terra_ControlMode_Manual;
    }
    return Terra_ControlMode_Disabled;
}

inline Terra_RouteState terraDecodeRouteState(const TerraString &routeStateStr)
{
    switch (terraTrieChar(routeStateStr, 0)) {
        case 'a':
            return Terra_RouteState_Active;
        case 'c':
            return Terra_RouteState_Complete;
        case 'f':
            return Terra_RouteState_Fault;
        case 'i':
            return Terra_RouteState_Idle;
        case 'r':
            return Terra_RouteState_Requested;
    }
    return Terra_RouteState_Idle;
}


#endif // /ifndef TerraEnumTrie_H
